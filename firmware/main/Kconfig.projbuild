## firmware/main/Kconfig.projbuild
```kconfig
menu "LLM Dashboard Configuration"

    config DEMO_LCD_ENABLE
        bool "Drive the on-board ST7796 LCD (Waveshare ESP32-S3-Touch-LCD-3.5)"
        default y
        help
            关闭后 LVGL 以 headless 方式运行，只通过串口输出刷新率。

    if DEMO_LCD_ENABLE

        config DEMO_LCD_H_RES
            int "LCD horizontal resolution"
            default 320

        config DEMO_LCD_V_RES
            int "LCD vertical resolution"
            default 480

        config DEMO_LCD_SPI_HOST
            int "SPI host (1 = SPI2_HOST, 2 = SPI3_HOST)"
            default 1

        config DEMO_LCD_PIN_MOSI
            int "GPIO MOSI"
            default 1

        config DEMO_LCD_PIN_SCLK
            int "GPIO SCLK"
            default 5

        config DEMO_LCD_PIN_DC
            int "GPIO DC"
            default 3

        config DEMO_LCD_PIN_CS
            int "GPIO CS (-1 = not connected)"
            default -1

        config DEMO_LCD_PIN_RST
            int "GPIO RESET (-1 = via IO expander)"
            default -1

        config DEMO_LCD_PIN_BL
            int "GPIO backlight PWM (-1 = disabled)"
            default 6

        config DEMO_LCD_PIXEL_CLOCK
            int "SPI pixel clock in Hz"
            default 80000000

        config DEMO_LCD_BRIGHTNESS
            int "Backlight brightness (%)"
            range 0 100
            default 80

        config DEMO_LCD_SWAP_XY
            bool "Swap X/Y"
            default n

        config DEMO_LCD_MIRROR_X
            bool "Mirror X"
            default y

        config DEMO_LCD_MIRROR_Y
            bool "Mirror Y"
            default n

        config DEMO_LCD_BGR
            bool "Use BGR element order"
            default y

        config DEMO_LCD_INVERT
            bool "Invert colors"
            default y

        config DEMO_LCD_USE_PSRAM
            bool "Allocate LVGL draw buffers in PSRAM"
            default y

        menu "IO expander (TCA9554, drives LCD reset)"

            config DEMO_EXPANDER_ENABLE
                bool "Use TCA9554 IO expander"
                default y

            if DEMO_EXPANDER_ENABLE

                config DEMO_EXPANDER_I2C_SDA
                    int "I2C SDA GPIO"
                    default 8

                config DEMO_EXPANDER_I2C_SCL
                    int "I2C SCL GPIO"
                    default 7

                config DEMO_EXPANDER_ADDR
                    hex "I2C address"
                    default 0x20

                config DEMO_EXPANDER_RST_PIN
                    int "Expander pin index used as LCD reset (0-7)"
                    range 0 7
                    default 1

                config DEMO_EXPANDER_RST_ACTIVE_LOW
                    bool "LCD reset is active low"
                    default y

            endif
        endmenu

    endif

    if !DEMO_LCD_ENABLE

        config DEMO_HEADLESS_H_RES
            int "Headless virtual resolution - width"
            default 320

        config DEMO_HEADLESS_V_RES
            int "Headless virtual resolution - height"
            default 240

    endif

endmenu
```

## firmware/sdkconfig.defaults
```kconfig
# 目标芯片与 Flash
CONFIG_IDF_TARGET="esp32s3"
# 实测板子：ESP32-S3 rev v0.2 + 16MB Flash + 8MB 八线 PSRAM（N16R8）
CONFIG_ESPTOOLPY_FLASHSIZE_16MB=y

# 八线 PSRAM：LVGL 缓冲、HTTP 响应、字体都放这里
CONFIG_SPIRAM=y
CONFIG_SPIRAM_MODE_OCT=y
CONFIG_SPIRAM_SPEED_80M=y
CONFIG_SPIRAM_USE_MALLOC=y

# CPU 240MHz：LVGL 软件渲染是主要瓶颈，160MHz→240MHz 直接多 50% 算力
CONFIG_ESP_DEFAULT_CPU_FREQ_MHZ_240=y
CONFIG_ESP32S3_DEFAULT_CPU_FREQ_240=y

# 性能优先：默认 Debug 的 -Og 会让 LVGL 软件渲染慢一大截
CONFIG_COMPILER_OPTIMIZATION_PERF=y

# 系统节拍（LVGL 需要毫秒级 tick）
CONFIG_FREERTOS_HZ=1000
CONFIG_ESP_MAIN_TASK_STACK_SIZE=8192

# 应用分区 4MB（中文字体约 210KB + LVGL）
CONFIG_PARTITION_TABLE_CUSTOM=y
CONFIG_PARTITION_TABLE_CUSTOM_FILENAME="partitions.csv"

# LVGL：RGB565、深色仪表盘用到的字号
CONFIG_LV_COLOR_FORMAT_RGB565=y
CONFIG_LV_FONT_MONTSERRAT_10=y
CONFIG_LV_FONT_MONTSERRAT_12=y
CONFIG_LV_FONT_MONTSERRAT_14=y
CONFIG_LV_FONT_MONTSERRAT_16=y
CONFIG_LV_FONT_MONTSERRAT_20=y
CONFIG_LV_FONT_MONTSERRAT_24=y
CONFIG_LV_FONT_MONTSERRAT_28=y
CONFIG_LV_FONT_MONTSERRAT_32=y
CONFIG_LV_FONT_MONTSERRAT_40=y
CONFIG_LV_FONT_MONTSERRAT_48=y

# 中文用自己生成的 lv_font_cjk_16，内置 CJK 字体关闭
# CONFIG_LV_FONT_SOURCE_HAN_SANS_SC_16_CJK is not set

# LVGL 堆走 libc malloc → 可用 PSRAM，避免占用内部 SRAM
# CONFIG_LV_USE_BUILTIN_MALLOC is not set
CONFIG_LV_USE_CLIB_MALLOC=y

CONFIG_LV_USE_SNAPSHOT=y
CONFIG_LV_USE_LODEPNG=y

# 运行时字体：SPIFFS 里的 binfont 按需加载（服务端按布局文字生成子集）
CONFIG_LV_USE_FS_POSIX=y
CONFIG_LV_FS_POSIX_LETTER=83
CONFIG_LV_FS_POSIX_PATH="/spiffs"
CONFIG_LV_FS_POSIX_CACHE_SIZE=0

# 串口：USB-Serial/JTAG（板子只有一个 USB-C，控制台必须走这里）
CONFIG_ESP_CONSOLE_USB_SERIAL_JTAG=y
CONFIG_ESP_CONSOLE_SECONDARY_NONE=y

# 加大指令缓存：LVGL 绘制代码在 flash，16KB 命中率太低
CONFIG_ESP32S3_INSTRUCTION_CACHE_32KB=y

# 16ms 刷新周期：小区域更新更跟手（整屏仍受渲染耗时限制）
CONFIG_LV_DEF_REFR_PERIOD=16
```
